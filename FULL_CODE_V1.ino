#include <SPI.h>
#include <OneWire.h>
#include <DallasTemperature.h>

#define ONE_WIRE_BUS 5

////////////SCREEN CONSTANTS///////////
const int DC = 8;
const int BACKLIGHT = 7;

const int CMD = LOW;
const int DATA = HIGH;
const int ON = HIGH;
const int OFF = LOW;
const int LCD_WIDTH = 84;
const int LCD_HEIGHT = 48;
const char FONT_TABLE [][5] = {
    { 0x00, 0x00, 0x00, 0x00, 0x00 }, // 0x20, space
    { 0x00, 0x00, 0x5f, 0x00, 0x00 }, // 0x21, !
    { 0x00, 0x07, 0x00, 0x07, 0x00 }, // 0x22, "
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    { 0x78, 0x46, 0x41, 0x46, 0x78 }  // 0x7f, DEL
};
const char eTinkersLogo[504] = {
  0x00, 0x00, 0x00, 0x00, 0x00, 0x00, 0x00, 0x00, 0xe0, 0xf0, 0xf0, 0xf8,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 0x00,
  0x00, 0x00, 0x00, 0x00, 0x00, 0x00, 0x00, 0x00, 0xff, 0xff, 0xff, 0xff,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 0x00,
  0x00, 0x00, 0x00, 0x00, 0x00, 0x00, 0x00, 0x00, 0xff, 0xff, 0xff, 0xff,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 0x00,
  0x00, 0x00, 0x00, 0x00, 0x00, 0x00, 0x00, 0x00, 0xff, 0xff, 0xff, 0xff,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 0x00,
  0xf0, 0xf8, 0xf8, 0xf8, 0xf8, 0xf8, 0xf8, 0xf8, 0xff, 0xff, 0xff, 0xff,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 0xf0,
  0x00, 0x01, 0x07, 0x0f, 0x0f, 0x1f, 0x1f, 0x1f, 0x1f, 0x1f, 0x1f, 0x1f,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 0x00
};

const char peen[504]  =
{
0x00, 0x00, 0x00, 0x00, 0x00, 0x00, 0x00, 0x00, 0x00, 0x00, 0x00, 0x00,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 0x00
};

const char startup[504] =
{
0x00, 0x00, 0x00, 0x00, 0x00, 0x00, 0x00, 0x00, 0x00, 0x00, 0x00, 0x00,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 0x00
};
uint8_t _inverse = OFF;

///////////////////////////////////

//////SOIL TEMP CONSTANTS////////
#define t_dat A2
OneWire oneWire(ONE_WIRE_BUS);
DallasTemperature sensors_temp(&oneWire);

float Celcius=0;
float Fahrenheit=0;
/////////////////////////////////

/////SOIL MOISTURE CONSTANTS//////
#define m_pow A5;
#define m_dat A4;
static int MOISTURE_MIN = 234;
static int MOISTURE_MAX = 1008;
int moisture = 0;
//////////////////////////////////

///////JOYSTICK CONSTANTS////////
const int jy = A0;
const int jx = A1;
const int swPin = 12;

int xDirection = 0;
int yDirection = 0;
int switchState = 1;
/////////////////////////////////

//////////LDR CONSTANTS//////////
#define R 10000 //ohm resistance value
// Parameters
const int sensorPin = A3; // Pin connected to sensor

//Variables
int sensorVal; // Analog value from the sensor
int lux; //Lux value

int ldrPin = A0; // select the input pin for LDR
int sensorValue = 0; // variable to store the value coming from the sensor
/////////////////////////////////

void _write(const uint8_t mode, char data) {
  SPI.beginTransaction(SPISettings(16000000, MSBFIRST, SPI_MODE0));
  digitalWrite(SS, LOW);
  digitalWrite(DC, mode);  //HIGH = Data mode, LOW = Command mode
  if (mode == DATA & _inverse == ON) {
      data = ~ data;
  }
  SPI.transfer(data);
  digitalWrite(SS, HIGH);
  SPI.endTransaction();
}

void inverse(const uint8_t inv) {
  _inverse = inv;
}

void clear(void) {
  cursor(1, 1);
  for (int pixel = (LCD_WIDTH * LCD_HEIGHT / 8); pixel > 0; pixel--) {
    _write(DATA, 0x00);
  }
}

void cursor(uint8_t row, uint8_t col) {
  if ( (row < 1 | row > LCD_HEIGHT / 8) | (col < 1 | col > LCD_WIDTH / 6)) {
    return;
  }
  _write(CMD, 0x40 | ( row -1 ) );
  _write(CMD, 0x80 | ( col -1) * 6 );
}

void backlight(const uint8_t state) {
  digitalWrite(BACKLIGHT, state);
}

void printStr(const char *str) {
  int p = 0;
  while (str[p]!='\0') {
    if ( (str[p] >= 0x20) & (str[p] <= 0x7f) ) {
      for (int i = 0; i < 5; i++) {
        _write(DATA, FONT_TABLE[str[p] - 32][i]);
      }
      _write(DATA, 0x00);
    }
    p++;
  }
}

void printImage(const char *image) {
  cursor(1,1);
  for (int i = 0; i < (LCD_WIDTH * LCD_HEIGHT / 8); i++) {
    _write(DATA, image[i]);
  }
}

void setup() {
    Serial.begin(9600);
    ////////////////////////LCD Screen SETUP/////////////////////////////
    pinMode(DC, OUTPUT);
    pinMode(BACKLIGHT, OUTPUT);
    pinMode(SS, OUTPUT);
    digitalWrite(SS, HIGH);

    SPI.begin();
    _write(CMD, 0x21);  // Set Extended Command set
    _write(CMD, 0xb2);  // Set Vlcd to 6v (LCD Contrast)
    _write(CMD, 0x13);  // Set voltage bias system 1:48 (Viewing Angle)
    _write(CMD, 0x20);  // Set Normal Command set
    clear(); // Clear all display memory and set cursor to 1,1
    _write(CMD, 0x09);  // Set all pixels ON
    _write(CMD, 0x0c);  // Set display mode to Normal
    ////////////////////////////////////////////////////////////////////

    /////SOIL MOISTURE SETUP/////
    /////////////////////////////
    
    /////SOIL TEMP SETUP/////
    temp_sensors.begin();
    /////////////////////////

    ///////JOYSTICK SETUP///////
    pinMode(swPin, INPUT);
    digitalWrite(swPin, HIGH);
    ///////////////////////////
    
}

void loop() {
  printImage(startup);
  delay(5000);
  clear();
  cursor(1, 1);  
  printStr("Hello World!!!");
  cursor(3, 2);
  printStr("Engineering");
  cursor(4, 5);
  printStr("Design");
  inverse(ON);
  cursor(6,4);
  printStr("Poggers");
  inverse(OFF);
  delay(500000);

  clear();

}
